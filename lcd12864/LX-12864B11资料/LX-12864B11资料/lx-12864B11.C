/*************************************************************/
// project    :	221-3059-1428
// driver IC  :	st7567
// LCD        :	1/65 duty, 1/9bias, 8.8V vop
// interface  :	SPI
// ver        :	00
// date       :  -07
// other      :	VDD 3.1v
/**************************************************************/
#include "reg51.h"
/*

  sbit RS  = P3^7;
  sbit RES = P3^3;
  sbit CS  = P3^4;
  sbit SCL = P1^1;
  sbit SDI = P1^0;
*/
  sbit RS  = P3^7;
  sbit RES = P3^3;
  sbit CS  = P3^4;
  sbit SCL = P1^1;
  sbit SDI = P1^0;

//  sbit SCL = P1^6;
//  sbit SDI = P1^7;
  sbit    key1=P2^1;
  sbit    key2=P2^2;
  sbit    pause=P2^0;
void writec(uchar);
void stop(void);
void writed(uchar);

#define  uchar  unsigned char
#define  uint   unsigned int
 uchar vop=0x29;

uchar code chara1[]= {
 /*--  调入了一幅图像：D:\ASM\Jun\#CMGG12864R\1.bmp  --*/
/*--  宽度x高度=128x64  --*/
0xFF,0x01,0x01,0x01,0x01,0x01,0x09,0x09,0xFD,0xFD,0x01,0x01,0x01,0x01,0x01,0x01,
0x01,0x01,0x01,0x01,0x01,0x01,0x01,0x01,0x01,0x01,0x01,0x01,0x01,0x01,0x01,0x01,
0x01,0x01,0x01,0x01,0x01,0x01,0x01,0x01,0x01,0x01,0x01,0x01,0x01,0x01,0x01,0x01,
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0xBF,0xBF,0xA0,0xA0,0x80,0x80,0x80,0x80,0x80,0x80,0x80,0x80,0x80,0x80,0x80,0xFF



 };




 uchar code chara2[]=

{
/*--  调入了一幅图像：D:\ASM\Jun\#CMGG12864R\Q.bmp  --*/
/*--  宽度x高度=128x64  --*/
0xE0,0x10,0x08,0x08,0x08,0x10,0xE0,0x00,0xE0,0x10,0x08,0x08,0x08,0x10,0xE0,0x00,
0xE0,0x10,0x08,0x08,0x08,0x10,0xE0,0x00,0xE0,0x10,0x08,0x08,0x08,0x10,0xE0,0x00,
0xE0,0x10,0x08,0x08,0x08,0x10,0xE0,0x00,0xE0,0x10,0x08,0x08,0x08,0x10,0xE0,0x00,
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0x0F,0x18,0x24,0x24,0x38,0x50,0x4F,0x00,0x0F,0x18,0x24,0x24,0x38,0x50,0x4F,0x00


};

 void delay1(unsigned int t)
{
  while(t>0)
  {
    t--;             //TT-					   `
    pause=1;
    if(pause==0)stop();
  }
}


 void flash(unsigned int t)
{
  while(t>0)
  {
    t--;             //TT-					   `


  }
}
//-----------------------------
        void stop()
        {
         flash(100);
         while(pause==0)
         {
          pause=1;
          key1=1;
          key2=1;
          if(key1==0)
          {
          flash(200);
          if(key1==0)
          {

          while(key1==0);
          flash(100);
            if(vop<63)
            {
            vop++;
			writec(0x81);
            writec(vop);}
            }
		 }
          else if(key2==0)
          {
           flash(100);
		   if(key2==0)
          {

           while(key2==0);
           flash(100);
           if(vop>0)
           {
            vop--;
			writec(0x81);
            writec(vop);
			}
           }
          }
         }
	   }

void writec(uchar com)
{ unsigned char i ;
	CS=0;
	RS=0;

   for(i=0;i<8;i++)
    { com=com<<1;
	  SDI=CY;
	  SCL=1;
	  SCL=0;
	  }

    CS=1;
	RS=1;
 }

void writed(uchar dat)
{  unsigned char i;
	CS=0;
    RS=1;

  for(i=0;i<8;i++)
    {

	  dat=dat<<1;
	  SDI=CY;
	  SCL=1;
	  SCL=0;
	  }

    CS=1;
	RS=1;
}

 void init ( )
{
	  uchar col;
   RES=1;
   flash(1000);
   RES=0;
   flash(2000);
   RES=1;
   flash(1000);

 writec(0xe3);  // reset signal
 writec(0xa2);  //(0xa2 1/9 bias,1/65 duty )
 writec(0xa0);  // ADC select
 writec(0xc8);  // command output select
 writec(0x2f);  // power control
 writec(0x24);  // select resistor ratio Rb/Ra
 writec(0x81);  // select volume
 writec(vop);   // vop
 writec(0xf8);  // x4
 writec(0x08);  // x4
  writec(0xb0);//set page address
      writec(0x10);//set column address
      writec(0x00);
      for(col=0;col<128;col++)
      {
         writed(0x00);

      }
 writec(0xaf);  //display on
}


void display(uchar dat1,uchar dat2)
{
   uchar row,col;

   for (row=0xb0; row<0xb8; row++)    //0XB0    0XB8
   {
      writec(row);//set page address
      writec(0x10);//set column address
      writec(0x00);
      for(col=0;col<128;col++)
      {
         writed(dat1);
         writed(dat2);
      }
   }

   delay1(50000);

}

void displaychar(uchar *p)
{
   uchar row,col;

   for (row=0xb0; row<0xb8; row++)
   {
      writec(row);//set page address
      writec(0x10);//set column address
      writec(0x00);
      for(col=0;col<128;col++)
      writed(*p++);
   }

   delay1(50000);

}
void main(void)
{
   delay1(1000);

    vop=0x29;	 //vop=9.1V
	//vop=0x15;	 //vop=7.1V
   init();
  while (1)
  {
      display(0xff,0xff);
      display(0x00,0x00);
      display(0x55,0xaa);
      display(0xaa,0x55);
      displaychar(chara1);
      displaychar(chara2);//vop_test();
  }
}
